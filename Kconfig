## Kconfig
```kconfig
mainmenu "RTMux Configuration"

choice
    prompt "CPU architecture"
    default ARCH_RISCV
config ARCH_RISCV
    bool "RISC-V RV64"
config ARCH_AARCH64
    bool "AArch64 Raspberry Pi 3B"
endchoice

config SMP
    bool "Symmetric Multi-Processing (SMP)"
    default y

choice
    prompt "POSIX conformance profile"
    default POSIX_PROFILE_FULL
    help
      Selects which POSIX option macros the public headers and sysconf()
      advertise.  scripts/posix_profile.py defines each profile's option set;
      a smaller profile de-advertises the options outside it (via the generated
      include/sys/posix-profile-trim.h).  FULL is the current behavior -- every
      implemented option advertised -- and trims nothing.  The order is a
      partial one: minimal is a subset of both realtime and lkl, which are
      subsets of full, but realtime and lkl are incomparable.

config POSIX_PROFILE_MINIMAL
    bool "minimal (PSE51 mandatory realtime)"

config POSIX_PROFILE_REALTIME
    bool "realtime (PSE52 filesystem + PSE53 process)"

config POSIX_PROFILE_LKL
    bool "lkl (the measured LKL-domain floor)"

config POSIX_PROFILE_FULL
    bool "full (every advertised option)"

endchoice

config LKL_SERVERS
    bool "LKL Linux-domain servers (lkl-fsd, lkl-netd)"
    default n
    depends on POSIX_PROFILE_LKL || POSIX_PROFILE_FULL
    help
      Build and ship the Linux Kernel Library personality servers in
      initramfs.  These link a large prebuilt LKL archive extracted from
      externals/lkl-rv64/, so the default build leaves them off; enable
      this once the LKL artifacts are present.

      This option is valid only when the POSIX conformance profile is lkl or
      full.  The servers pull the libc surface in
      scripts/posix_profile.LKL_FLOOR, which smaller profiles do not
      advertise.  scripts/check-lkl-profile.py additionally rejects a stale
      hand-edited pairing that bypasses this dependency.

config ULOCK_DEBUG
    bool "Userspace lock-rank checker for threaded servers"
    default n
    help
      Debug-only lockdep-style checker for userspace pthread mutexes.  Each
      thread keeps a stack of the mutexes it currently holds; every acquire
      records a directed "held-before" edge between lock addresses in a global
      graph.  If the reverse edge already exists the checker has seen both
      A-then-B and B-then-A orderings across threads -- a classic AB/BA
      deadlock -- so it prints the two lock addresses, the two acquire-site
      program counters (feed them to addr2line for file:line), and the tid,
      then abort()s.

      This adds a malloc'd per-thread held-stack and a global edge table, so
      leave it off for production builds; it is meant for debugging threaded
      servers.  With this off the hooks compile to nothing (zero cost).

config SERVER_POOL_CANARY
    bool "Redzone canaries on fixed server object pools"
    default n
    help
      Debug-only redzone canaries around the fixed-size object pools that
      servers keep for open contexts and requests (for example the lkl-fsd
      OCB pool and the roottask capfs/cpiofs/sysfs pools).  Each pooled object
      gets a magic value before its first and after its last member; the pool
      arms them on alloc and verifies them on free and before replying with
      pooled data.  An overflow that runs past one object corrupts the next
      object's canary, so the checker aborts with the pool name and slot index.

      With this off the canary members and hooks compile to nothing, so a
      normal build has no layout or runtime change; leave it off for
      production builds.

source "arch/riscv/Kconfig"
source "arch/aarch64/Kconfig"
source "kernel/Kconfig"
source "servers/roottask/Kconfig"
```

## arch/aarch64/Kconfig
```kconfig
if ARCH_AARCH64
config PI3_RAM_SIZE_MB
    int "Pi3 RAM available to RTMux (MiB)"
    range 160 960
    default 960
    help
      The upper 64 MiB is reserved for the firmware/GPU. A smaller limit
      permits bounded low-memory validation; 256 matches the RISC-V QEMU
      regression environment. The initramfs at 128 MiB must still fit.
config PAGE_OFFSET
    hex
    default 0xffffffc000000000
config PA_BITS
    int
    default 32
config VA_BITS
    int
    default 39
endif
```

## arch/riscv/Kconfig
```kconfig
if ARCH_RISCV

config PAGE_OFFSET
    hex "Kernel virtual address base (PAGE_OFFSET)"
    default 0xffffffe000000000

config PA_BITS
    int "Physical address bits"
    default 56

config VA_BITS
    int "Virtual address bits"
    default 39

endif
```

## configs/pi3_defconfig
```kconfig
CONFIG_ARCH_AARCH64=y
CONFIG_POSIX_PROFILE_FULL=y
# CONFIG_LKL_SERVERS is not set
CONFIG_PROCESSORS_MAX=4
```

## servers/roottask/Kconfig
```kconfig
menu "Roottask"

config ROOTTASK_HEAP_SIZE
    int "Roottask malloc heap size (bytes)"
    default 1048576
    range 131072 16777216
    help
      Size of the fixed arena that backs roottask's malloc. Roottask is the
      mmap server, so unlike every other process it cannot grow its heap
      by mapping memory. Must be a multiple of 4096.

      The allocator keeps freed blocks in their size class, so the arena
      must hold the peak of every class at once; /sys/kstats reports how
      much is used (roottask.heap_used). Concurrent spawns under the
      leak-gate suite peak near 768 KiB, which 512 KiB could not hold.

      Default: 1048576 (1 MiB).

config ROOTTASK_SYSLOG_SIZE
    int "Roottask log buffer size (bytes)"
    default 1048576
    help
      Size of the roottask ring buffer for diagnostic messages.
      All root_log/root_dbg/root_trace output is stored here and can
      be read as /sys/log (mode 0400, root only).

      Default: 1048576 (1 MiB).

config ROOTTASK_SYSLOG_STDOUT
    bool "Echo roottask log to console"
    default y
    help
      When enabled, roottask log messages are also printed to the
      system console via kprintf.  Debug and trace messages are
      filtered by the kernel's loglevel (-v / -vv).

      Disable this to suppress all roottask console output and
      rely solely on the ring buffer.

endmenu
```
